## zigbee-multi-sensor/sdkconfig.defaults
```kconfig
# ESP32-C6 Zigbee Configuration

# Enable Zigbee support
CONFIG_ZB_ENABLED=y
CONFIG_ZB_ZCZR=y
CONFIG_ZB_RADIO_MODE_NATIVE=y

# Zigbee Channel (11-26)
CONFIG_ZB_CHANNEL=11

# Zigbee Extended PAN ID
CONFIG_ZB_EXTPANID="DD:DD:DD:DD:DD:DD:DD:DD"

# IEEE 802.15.4 (required for Zigbee)
CONFIG_IEEE802154_ENABLED=y

# NVS (required for Zigbee credential storage)
CONFIG_NVS_ENCRYPTION=n

# FreeRTOS (Zigbee stack requirements)
CONFIG_FREERTOS_HZ=1000

# ESP32-C6 specific
CONFIG_IDF_TARGET="esp32c6"
CONFIG_IDF_TARGET_ESP32C6=y

# Bootloader
CONFIG_BOOTLOADER_LOG_LEVEL_INFO=y

# Partition table
CONFIG_PARTITION_TABLE_CUSTOM=y
CONFIG_PARTITION_TABLE_CUSTOM_FILENAME="partitions.csv"

# Main task stack size (Zigbee needs more stack)
CONFIG_ESP_MAIN_TASK_STACK_SIZE=4096

# Enable console output
CONFIG_ESP_CONSOLE_UART_DEFAULT=y
CONFIG_ESP_CONSOLE_UART_NUM=0
CONFIG_ESP_CONSOLE_UART_BAUDRATE=115200

# Compiler optimizations
CONFIG_COMPILER_OPTIMIZATION_SIZE=y

# Debug settings
CONFIG_LOG_DEFAULT_LEVEL_INFO=y
CONFIG_LOG_MAXIMUM_LEVEL_VERBOSE=y
```
